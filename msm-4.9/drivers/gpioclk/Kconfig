## msm-4.9/drivers/gpioclk/Kconfig
```kconfig
config GPIO_CLK
    tristate "gpio clock  driver"
    default n
    help
      This is the main file for gpio clock.

      Say Y here if you have a gpio clock connected to your system.

      If unsure, say N.

      To compile this driver as a module, choose M here.
```

## msm-4.9/drivers/misc/dev_info/Kconfig
```kconfig
config DEV_INFO
	tristate "Device info"
	default y
	---help---
	  This driver provides device info.
```

## msm-4.9/drivers/misc/hi_3w/Kconfig
```kconfig
config HI_3W
    tristate "3wire host interface"
    depends on GPIOLIB
    help
      This driver provides a host interface for other drivers to send commands to MCU
```

## msm-4.9/drivers/misc/j1708/Kconfig
```kconfig
config J1708
	tristate "virtual J1708 interface, for apps and iodriver"
	default n
	---help---
	  This driver provides a virtual interface to send and recieve messages from the MCU's J1708.
```
